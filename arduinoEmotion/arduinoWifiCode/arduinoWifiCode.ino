// code
// https://randomnerdtutorials.com/esp8266-nodemcu-http-get-post-arduino/


#include <ESP8266WiFi.h>
#include <ESP8266HTTPClient.h>
#include <WiFiClient.h>
#include "LedControl.h"

unsigned char normalA[][8] = {\
  {0x00,0x00,0x80,0x80,0x80,0x80,0x00,0x00},\
  {0x00,0x00,0x80,0x80,0x80,0x80,0x00,0x00},\
  {0x00,0x00,0x80,0x80,0x80,0x80,0x00,0x00},\
  {0x00,0x00,0x80,0x80,0x80,0x80,0x00,0x00},\
  {0x00,0x00,0x00,0x80,0x80,0x00,0x00,0x00},\
  {0x00,0x00,0x00,0x80,0x80,0x00,0x00,0x00},\
};
unsigned char normalB[][8] = {\
  {0x7e,0xff,0xe7,0xc3,0xc3,0xe7,0xff,0x7e},\
  {0x7e,0xff,0xe7,0xc3,0xc3,0xe7,0xff,0x7e},\
  {0x7e,0xff,0xe7,0xc3,0xc3,0xe7,0xff,0x7e},\
  {0x7e,0xff,0xe7,0xc3,0xc3,0xe7,0xff,0x7e},\
  {0x00,0x00,0x00,0xff,0xff,0x00,0x00,0x00},\
  {0x00,0x00,0x00,0xff,0xff,0x00,0x00,0x00},\
};
unsigned char normalC[][8] = {\
  {0x00,0x00,0x01,0x01,0x01,0x01,0x00,0x00},\
  {0x00,0x00,0x01,0x01,0x01,0x01,0x00,0x00},\
  {0x00,0x00,0x01,0x01,0x01,0x01,0x00,0x00},\
  {0x00,0x00,0x01,0x01,0x01,0x01,0x00,0x00},\
  {0x00,0x00,0x00,0x01,0x01,0x00,0x00,0x00},\ 
  {0x00,0x00,0x00,0x01,0x01,0x00,0x00,0x00},\ 
};

unsigned char happyA[][8] = {\
  {0x00,0x60,0xe0,0xc0,0x80,0x00,0x00,0x00},\
  {0x00,0x00,0x60,0xe0,0xc0,0x80,0x00,0x00},\ 
};
unsigned char happyB[][8] = {\
  {0x00,0x00,0x00,0x81,0xff,0xff,0x00,0x00},\ 
  {0x00,0x00,0x00,0x00,0x81,0xff,0xff,0x00},\ 
};
unsigned char happyC[][8] = {\
  {0x00,0x06,0x07,0x03,0x01,0x00,0x00,0x00},\
  {0x00,0x00,0x06,0x07,0x03,0x01,0x00,0x00},\ 
};
unsigned char happyRA[][8] = {\
  {0x00,0x00,0x00,0x80,0xc0,0xe0,0x60,0x00},\ 
  {0x00,0x00,0x80,0xc0,0xe0,0x60,0x00,0x00},\  
};
unsigned char happyRB[][8] = {\
  {0x00,0x00,0xff,0xff,0x81,0x00,0x00,0x00},\ 
  {0x00,0xff,0xff,0x81,0x00,0x00,0x00,0x00},\ 
};
unsigned char happyRC[][8] = {\
  {0x00,0x00,0x00,0x01,0x03,0x07,0x06,0x00},\ 
  {0x00,0x00,0x01,0x03,0x07,0x06,0x00,0x00},\  
};
unsigned char sadA[][8] = {\
  {0x00,0x00,0x00,0x00,0x00,0xc0,0xe0,0x70},\
};
unsigned char sadB[][8] = {\
  {0x00,0x00,0x00,0x00,0x08,0xff,0xff,0x00},\ 
  {0x00,0x00,0x00,0x08,0x1c,0xff,0xff,0x00},\ 
  {0x00,0x00,0x08,0x1c,0x1c,0xff,0xff,0x00},\ 
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  {0x08,0x00,0x00,0x00,0x00,0xff,0xff,0x00},\
};
unsigned char sadC[][8] = {\
  {0x00,0x00,0x00,0x00,0x0e,0x07,0x03,0x00},\
};
unsigned char sadRA[][8] = {\
  {0x00,0x03,0x07,0x0e,0x00,0x00,0x00,0x00},\ 
};
unsigned char sadRB[][8] = {\
  {0x00,0xff,0xff,0x08,0x00,0x00,0x00,0x00},\ 
  {0x00,0xff,0xff,0x1c,0x08,0x00,0x00,0x00},\ 
  {0x00,0xff,0xff,0x1c,0x1c,0x08,0x00,0x00},\ 
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  {0x00,0xff,0xff,0x00,0x00,0x00,0x00,0x08},\
};
unsigned char sadRC[][8] = {\
  {0x70,0xe0,0xc0,0x00,0x00,0x00,0x00,0x00},\
};
unsigned char angryA[][8] = {
    {0x00,0x00,0x01,0x03,0x06,0x0c,0x0c,0x0f},
    {0x00,0x00,0x03,0x06,0x0c,0x18,0x18,0x1f}
};
unsigned char angryB[][8] = {
    {0x7f,0xc0,0x8e,0x1f,0x3f,0x3f,0x1f,0xfc},
    {0xff,0xc0,0x1c,0x3e,0x7e,0x7f,0x3e,0xf8}
};
unsigned char angryC[][8] = {
    {0xc0,0x60,0x30,0x30,0x60,0xc0,0x00,0x00},
    {0x80,0xc0,0x60,0x60,0xc0,0x80,0x00,0x00}
};
unsigned char angryRA[][8] = {
    {0x0f,0x0c,0x0c,0x06,0x03,0x01,0x00,0x00},
    {0x07,0x06,0x06,0x03,0x01,0x00,0x00,0x00}
};
unsigned char angryRB[][8] = {
    {0xfc,0x1f,0x3f,0x3f,0x1f,0x8e,0xe0,0x7f},
    {0xfe,0x0f,0x1f,0x1f,0x8f,0xc7,0x60,0x3f}
};
unsigned char angryRC[][8] = {
    {0x00,0x00,0xc0,0x60,0x30,0x30,0x60,0xc0},
    {0x00,0x80,0xe0,0xb0,0x98,0x18,0x30,0xe0}
};

int row, col, i, j;


LedControl lc = LedControl(2,4,0,4); 
LedControl lcR = LedControl(12,16,14,4);
 
void clean(){
  for(int i = 0; i < 3; i++)
    {lc.clearDisplay(i);
    lcR.clearDisplay(i);}
}


void setMatrix(String input) {
    if (input=="normal-4"){
      for (i = 0; i<6; i++)
      {
        for (j = 0; j<8; j++)
        {
          lc.setRow(2,j,normalA[i][j]);
          lc.setRow(1,j,normalB[i][j]);
          lc.setRow(0,j,normalC[i][j]);
          lcR.setRow(2,j,normalA[i][j]);
          lcR.setRow(1,j,normalB[i][j]);
          lcR.setRow(0,j,normalC[i][j]);
        }
        if (Serial.available()) break;
        delay(300);
      }
    }
  else if (input=="happy-3"){
    for (i = 0; i<2; i++)
      {
        for (j = 0; j<8; j++)
        {
          lc.setRow(2,j,happyA[i][j]);
          lc.setRow(1,j,happyB[i][j]);
          lc.setRow(0,j,happyC[i][j]);
          lcR.setRow(2,j,happyRA[i][j]);
          lcR.setRow(1,j,happyRB[i][j]);
          lcR.setRow(0,j,happyRC[i][j]);
        }
        if (Serial.available()) break;
        delay(200);      
      }
  }

  else if (input=="sad-4"){
    for (i = 0; i<8; i++)
      {
        for (j = 0; j<8; j++)
        {
          lc.setRow(2,j,sadA[0][j]);
          lc.setRow(1,j,sadB[i][j]);
          lc.setRow(0,j,sadC[0][j]);
          lcR.setRow(0,j,sadRA[0][j]);
          lcR.setRow(1,j,sadRB[i][j]);
          lcR.setRow(2,j,sadRC[0][j]);
        }
        if (Serial.available()) break;
        delay(100);
      }
  }

  else if (input=="angry-4"){
    for (i = 0; i<2; i++)
      {
        for (j = 0; j<8; j++)
        {
          lc.setRow(0,j,angryA[i][j]);
          lc.setRow(1,j,angryB[i][j]);
          lc.setRow(2,j,angryC[i][j]);
          lcR.setRow(0,j,angryRA[i][j]);
          lcR.setRow(1,j,angryRB[i][j]);
          lcR.setRow(2,j,angryRC[i][j]);
        }
        if (Serial.available()) break;
        delay(100);
      }
  }
}

const char* ssid = "wifi";
const char* password = "pwd";

//Your Domain name with URL path or IP address with path
String serverName = "ipaddress";

// the following variables are unsigned longs because the time, measured in
// milliseconds, will quickly become a bigger number than can be stored in an int.
unsigned long lastTime = 0;
unsigned long timerDelay = 50;
String emotion = "";


void setup() {
  Serial.begin(115200); 

  WiFi.begin(ssid, password);
  Serial.println("Connecting");
  while(WiFi.status() != WL_CONNECTED) {
    delay(200);
    Serial.print(".");
  }
  Serial.println("");
  Serial.print("Connected to WiFi network with IP Address: ");
  Serial.println(WiFi.localIP());
  Serial.println("Timer set to 5 seconds (timerDelay variable), it will take 5 seconds before publishing the first reading.");
  
  for(int i=0; i<3; i++){
    lc.shutdown(i,false);
    lc.setIntensity(i,5);
    lc.clearDisplay(i);
    lcR.shutdown(i,false);
    lcR.setIntensity(i,5);
    lcR.clearDisplay(i);
  }

}

void loop() {
  // Send an HTTP POST request depending on timerDelay
  if ((millis() - lastTime) > timerDelay) {
    //Check WiFi connection status
    if(WiFi.status()== WL_CONNECTED){
      WiFiClient client;
      HTTPClient http;

      String serverPath = serverName + "/getEmo";
      
      // Your Domain name with URL path or IP address with path
      http.begin(client, serverPath.c_str());
  

      // Send HTTP GET request
      int httpResponseCode = http.GET();
      
      if (httpResponseCode>0) {
        Serial.print("HTTP Response code: ");
        Serial.println(httpResponseCode);
        String payload = http.getString();
        Serial.println(payload);
        setMatrix(payload);
      }
      else {
        Serial.print("Error code: ");
        Serial.println(httpResponseCode);
      }
      // Free resources
      http.end();
    }
    else {
      Serial.println("WiFi Disconnected");
    }
    lastTime = millis();
  }
}